## config/boards/shields/urchin/Kconfig.defconfig
```kconfig
# SPDX-License-Identifier: MIT

if SHIELD_DONGLE

# Max 16 characters in keyboard name
config ZMK_KEYBOARD_NAME
    default "urchin"

config ZMK_SPLIT_ROLE_CENTRAL
    default y

config ZMK_SPLIT
    default y

endif

if SHIELD_URCHIN_LEFT

config ZMK_KEYBOARD_NAME
    default "urchinL"

config ZMK_SPLIT
    default y

endif

if SHIELD_URCHIN_RIGHT

config ZMK_KEYBOARD_NAME
    default "urchinR"

config ZMK_SPLIT
    default y

endif
```

## config/west.yml
```yaml
manifest:
  remotes:
    # zmk official
    - name: zmkfirmware
      url-base: https://github.com/zmkfirmware
      # bravekarma
#    - name: caksoylar
#      url-base: https://github.com/caksoylar
#      # kyek / duckyb
#    - name: duckyb
#      url-base: https://github.com/duckyb
  projects:
    - name: zmk
      remote: zmkfirmware
      import: app/west.yml
    - name: urchin-zmk-module
      remote: duckyb

    # ZMK modules
    - name: zmk-adaptive-key
      path: modules/zmk/adaptive-key
    - name: zmk-auto-layer
      path: modules/zmk/auto-layer
    - name: zmk-helpers
      path: modules/zmk/helpers
    - name: zmk-leader-key
      path: modules/zmk/leader-key
    - name: zmk-tri-state
      path: modules/zmk/tri-state

    # Temporarily overload Zephyr until
    # https://github.com/zmkfirmware/zephyr/pull/40 is merged.
    - name: zephyr
     revision: v3.5.0+zmk-fixes
     clone-depth: 1
     import:
       # Only enable most commonly used boards. For less common hardware one
       # may need to enable additional modules.
       name-allowlist:
         - cmsis
         - hal_nordic
         - hal_rpi_pico
         - hal_stm32
         - lvgl
         - tinycrypt
  self:
    path: config
```
